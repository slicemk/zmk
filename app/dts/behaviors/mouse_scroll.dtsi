/ {
    behaviors {
        /omit-if-no-ref/ msc: mouse_scroll {
            compatible = "zmk,behavior-mouse-scroll";
            #binding-cells = <1>;
            delay-ms = <0>;
            time-to-max-speed-ms = <300>;
            acceleration-exponent = <0>;
        };
    };
};
