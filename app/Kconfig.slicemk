## app/Kconfig.slicemk
```kconfig
config MAIN_STACK_SIZE
    default 2048

config SYSTEM_WORKQUEUE_STACK_SIZE
    default 2048

config ZMK_BEHAVIORS_QUEUE_SIZE
    default 512

config ZMK_BLE_THREAD_STACK_SIZE
    default 2048

config ZMK_SPLIT_CENTRAL_SPLIT_RUN_STACK_SIZE
    default 2048

# TODO TODO TODO not clear if it will be enabled globally once mouse keys is
# included in ZMK by default. for now this makes sense.
config ZMK_MOUSE
	default y
```

## app/boards/arm/nordic_nrf52840_dongle_slicemk/Kconfig.board
```kconfig
config BOARD_NORDIC_NRF52840_DONGLE_SLICEMK
    bool "Nordic nRF52840 Dongle SliceMK"
    depends on SOC_NRF52840_QIAA
```

## app/boards/arm/nordic_nrf52840_dongle_slicemk/Kconfig.defconfig
```kconfig
if BOARD_NORDIC_NRF52840_DONGLE_SLICEMK

config BOARD
    default "Nordic nRF52840 Dongle SliceMK"

if USB

config USB_NRFX
    default y

config USB_DEVICE_STACK
    default y

endif # USB

config BT_CTLR
    default BT

endif # BOARD_NORDIC_NRF52840_DONGLE_SLICEMK
```

## app/boards/arm/raytac_mdbt50q_cx_blue/Kconfig.board
```kconfig
config BOARD_RAYTAC_MDBT50Q_CX_BLUE
    bool "Raytac MDBT50Q-CX Blue"
    depends on SOC_NRF52840_QIAA
```

## app/boards/arm/raytac_mdbt50q_cx_blue/Kconfig.defconfig
```kconfig
if BOARD_RAYTAC_MDBT50Q_CX_BLUE

config BOARD
    default "Raytac MDBT50Q-CX Blue"

if USB

config USB_NRFX
    default y

config USB_DEVICE_STACK
    default y

endif # USB

config BT_CTLR
    default BT

endif # BOARD_RAYTAC_MDBT50Q_CX_BLUE
```

## app/boards/arm/raytac_mdbt50q_rx_green/Kconfig.board
```kconfig
config BOARD_RAYTAC_MDBT50Q_RX_GREEN
    bool "Raytac MDBT50Q-RX Green"
    depends on SOC_NRF52833_QIAA
```

## app/boards/arm/raytac_mdbt50q_rx_green/Kconfig.defconfig
```kconfig
if BOARD_RAYTAC_MDBT50Q_RX_GREEN

config BOARD
    default "Raytac MDBT50Q-RX Green"

if USB

config USB_NRFX
    default y

config USB_DEVICE_STACK
    default y

endif # USB

config BT_CTLR
    default BT

endif # BOARD_RAYTAC_MDBT50Q_RX_GREEN
```

## app/boards/arm/slicemk_1551usb3_ms88sfa_blue/Kconfig.board
```kconfig
config BOARD_SLICEMK_1551USB3_MS88SFA_BLUE
    bool "SliceMK 1551USB3 MS88SFA Blue"
    depends on SOC_NRF52840_QIAA
```

## app/boards/arm/slicemk_1551usb3_ms88sfa_blue/Kconfig.defconfig
```kconfig
if BOARD_SLICEMK_1551USB3_MS88SFA_BLUE

config BOARD
    default "SliceMK 1551USB3 MS88SFA Blue"

if USB

config USB_NRFX
    default y

config USB_DEVICE_STACK
    default y

endif # USB

config BT_CTLR
    default BT

endif # BOARD_SLICEMK_1551USB3_MS88SFA_BLUE
```

## app/boards/arm/slicemk_ergodox_202104/Kconfig.board
```kconfig
config BOARD_SLICEMK_ERGODOX_202104
    bool "SliceMK ErgoDox 202104"
    depends on SOC_NRF52840_QIAA
```

## app/boards/arm/slicemk_ergodox_202104/Kconfig.defconfig
```kconfig
if BOARD_SLICEMK_ERGODOX_202104

config BOARD
    default "SliceMK ErgoDox 202104"

if USB

config USB_NRFX
    default y

config USB_DEVICE_STACK
    default y

endif # USB

config BT_CTLR
    default BT

endif # BOARD_SLICEMK_ERGODOX_202104
```

## app/boards/arm/slicemk_ergodox_202108_blue/Kconfig.board
```kconfig
config BOARD_SLICEMK_ERGODOX_202108_BLUE_LEFT
    bool "SliceMK ErgoDox 202108 Blue Left"
    depends on SOC_NRF52840_QIAA

config BOARD_SLICEMK_ERGODOX_202108_BLUE_RIGHT
    bool "SliceMK ErgoDox 202108 Blue Right"
    depends on SOC_NRF52840_QIAA
```

## app/boards/arm/slicemk_ergodox_202108_blue/Kconfig.defconfig
```kconfig
if BOARD_SLICEMK_ERGODOX_202108_BLUE_LEFT || BOARD_SLICEMK_ERGODOX_202108_BLUE_RIGHT

config BOARD
    default "SliceMK ErgoDox 202108 Blue"

if USB

config USB_NRFX
    default y

config USB_DEVICE_STACK
    default y

endif # USB

config BT_CTLR
    default BT

endif # BOARD_SLICEMK_ERGODOX_202108_BLUE_LEFT || BOARD_SLICEMK_ERGODOX_202108_BLUE_RIGHT
```

## app/boards/arm/slicemk_ergodox_202108_green/Kconfig.board
```kconfig
config BOARD_SLICEMK_ERGODOX_202108_GREEN_LEFT
    bool "SliceMK ErgoDox 202108 Green Left"
    depends on SOC_NRF52833_QIAA

config BOARD_SLICEMK_ERGODOX_202108_GREEN_RIGHT
    bool "SliceMK ErgoDox 202108 Green Right"
    depends on SOC_NRF52833_QIAA
```

## app/boards/arm/slicemk_ergodox_202108_green/Kconfig.defconfig
```kconfig
if BOARD_SLICEMK_ERGODOX_202108_GREEN_LEFT || BOARD_SLICEMK_ERGODOX_202108_GREEN_RIGHT

config BOARD
    default "SliceMK ErgoDox 202108 Green"

if USB

config USB_NRFX
    default y

config USB_DEVICE_STACK
    default y

endif # USB

config BT_CTLR
    default BT

endif # BOARD_SLICEMK_ERGODOX_202108_GREEN_LEFT || BOARD_SLICEMK_ERGODOX_202108_GREEN_RIGHT
```

## app/boards/arm/slicemk_ergodox_202205_green/Kconfig.board
```kconfig
config BOARD_SLICEMK_ERGODOX_202205_GREEN_LEFT
    bool "SliceMK ErgoDox 202205 Green Left"
    depends on SOC_NRF52833_QIAA

config BOARD_SLICEMK_ERGODOX_202205_GREEN_RIGHT
    bool "SliceMK ErgoDox 202205 Green Right"
    depends on SOC_NRF52833_QIAA
```

## app/boards/arm/slicemk_ergodox_202207_green/Kconfig.board
```kconfig
config BOARD_SLICEMK_ERGODOX_202207_GREEN_LEFT
    bool "SliceMK ErgoDox 202207 Green Left"
    depends on SOC_NRF52833_QIAA

config BOARD_SLICEMK_ERGODOX_202207_GREEN_RIGHT
    bool "SliceMK ErgoDox 202207 Green Right"
    depends on SOC_NRF52833_QIAA
```

## app/boards/arm/slicemk_ergodox_202207_green/Kconfig.defconfig
```kconfig
if BOARD_SLICEMK_ERGODOX_202207_GREEN_LEFT || BOARD_SLICEMK_ERGODOX_202207_GREEN_RIGHT

config BOARD
    default "SliceMK ErgoDox 202207 Green"

if USB

config USB_NRFX
    default y

config USB_DEVICE_STACK
    default y

endif # USB

config BT_CTLR
    default BT

endif # BOARD_SLICEMK_ERGODOX_202207_GREEN_LEFT || BOARD_SLICEMK_ERGODOX_202207_GREEN_RIGHT
```

## app/boards/arm/slicemk_ergodox_202207_green/slicemk_ergodox_202207_green_right_defconfig
```kconfig
CONFIG_SOC_SERIES_NRF52X=y
CONFIG_SOC_NRF52833_QIAA=y
CONFIG_BOARD_SLICEMK_ERGODOX_202207_GREEN_RIGHT=y

# Follow DeviceTree partition.
CONFIG_USE_DT_CODE_PARTITION=y

# Build UF2 firmware.
CONFIG_BUILD_OUTPUT_UF2=y

# Enable MPU.
CONFIG_ARM_MPU=y

# Enable hardware stack protection.
CONFIG_HW_STACK_PROTECTION=y

# Enable basic functionality.
CONFIG_ADC=y
CONFIG_GPIO=y

# Allow P0.09 and P0.10 to be used as regular GPIOs.
CONFIG_NFCT_PINS_AS_GPIOS=y

# Use NVS for settings.
CONFIG_MPU_ALLOW_FLASH_WRITE=y
CONFIG_NVS=y
CONFIG_SETTINGS_NVS=y
CONFIG_FLASH=y
CONFIG_FLASH_PAGE_LAYOUT=y
CONFIG_FLASH_MAP=y

# The Adafruit bootloader allocates 7 pages for user data on nRF52833.
CONFIG_SETTINGS_NVS_SECTOR_COUNT=7

# Use maximum Bluetooth transmit power.
CONFIG_BT_CTLR_TX_PWR_PLUS_8=y

# Include support for Coded PHY.
CONFIG_BT_CTLR_PHY_CODED=y
```

## app/boards/arm/slicemk_usbc_mdbt50q_blue/Kconfig.board
```kconfig
config BOARD_SLICEMK_USBC_MDBT50Q_BLUE
    bool "SliceMK USBC MDBT50Q Blue"
    depends on SOC_NRF52840_QIAA
```

## app/boards/arm/slicemk_usbc_mdbt50q_blue/Kconfig.defconfig
```kconfig
if BOARD_SLICEMK_USBC_MDBT50Q_BLUE

config BOARD
    default "SliceMK USBC MDBT50Q Blue"

if USB

config USB_NRFX
    default y

config USB_DEVICE_STACK
    default y

endif # USB

config BT_CTLR
    default BT

endif # BOARD_SLICEMK_USBC_MDBT50Q_BLUE
```

## app/boards/shields/slicemk_ergodox/Kconfig.defconfig
```kconfig
if SHIELD_SLICEMK_ERGODOX_DONGLE || SHIELD_SLICEMK_ERGODOX_LEFTCENTRAL || SHIELD_SLICEMK_ERGODOX_LEFTSINGLE || SHIELD_SLICEMK_ERGODOX_RIGHTCENTRAL || SHIELD_SLICEMK_ERGODOX_RIGHTSINGLE

config ZMK_BLE
    default y

config ZMK_USB
    default y

config ZMK_KEYBOARD_NAME
    default "SliceMK ErgoDox"

endif

if SHIELD_SLICEMK_ERGODOX_DONGLE || SHIELD_SLICEMK_ERGODOX_LEFTCENTRAL || SHIELD_SLICEMK_ERGODOX_RIGHTCENTRAL

config ZMK_SPLIT
    default y

config ZMK_SPLIT_ROLE_CENTRAL
    default y

endif

if SHIELD_SLICEMK_ERGODOX_DONGLE

config ZMK_SPLIT_BLE_CENTRAL_PERIPHERALS
    default 2

config BT_MAX_PAIRED
    default 7

config BT_MAX_CONN
    default 7

config ZMK_SPLIT_BLE_PREF_INT
    default 6

config ZMK_SPLIT_BLE_PREF_LATENCY
    default 399

config ZMK_SPLIT_BLE_PREF_TIMEOUT
    default 900

endif
```

## app/boards/shields/slicemk_ergodox/Kconfig.shield
```kconfig
config SHIELD_SLICEMK_ERGODOX_DONGLE
    def_bool $(shields_list_contains,slicemk_ergodox_dongle)

config SHIELD_SLICEMK_ERGODOX_LEFTCENTRAL
    def_bool $(shields_list_contains,slicemk_ergodox_leftcentral)

config SHIELD_SLICEMK_ERGODOX_RIGHTCENTRAL
    def_bool $(shields_list_contains,slicemk_ergodox_rightcentral)

config SHIELD_SLICEMK_ERGODOX_LEFTSINGLE
    def_bool $(shields_list_contains,slicemk_ergodox_leftsingle)

config SHIELD_SLICEMK_ERGODOX_RIGHTSINGLE
    def_bool $(shields_list_contains,slicemk_ergodox_rightsingle)
```

## app/dts/bindings/behaviors/zmk,behavior-gpregret2.yaml
```yaml
description: SliceMK GPREGRET2 Behavior

compatible: "zmk,behavior-gpregret2"

include: zero_param.yaml

properties:
  type:
    type: int
    default: 0
```

## app/west.yml
```yaml
manifest:
  remotes:
    - name: zephyrproject-rtos
      url-base: https://github.com/zephyrproject-rtos
    - name: zmkfirmware
      url-base: https://github.com/zmkfirmware
  projects:
    - name: zephyr
      remote: zmkfirmware
      revision: v3.5.0+zmk-fixes
      clone-depth: 1
      import:
        name-whitelist:
          # Zephyr modules for building firmware
          - cmsis
          - hal_nordic
          - hal_rpi_pico
          - lvgl
          - segger
          - tinycrypt
          - zcbor
          # Babblesim modules for testing
          - bsim
          - babblesim_base
          - babblesim_ext_2G4_libPhyComv1
          - babblesim_ext_2G4_phy_v1
          - babblesim_ext_2G4_channel_NtNcable
          - babblesim_ext_2G4_channel_multiatt
          - babblesim_ext_2G4_modem_magic
          - babblesim_ext_2G4_modem_BLE_simple
          - babblesim_ext_2G4_device_burst_interferer
          - babblesim_ext_2G4_device_WLAN_actmod
          - babblesim_ext_2G4_device_playback
          - babblesim_ext_libCryptov1
          - nrf_hw_models
    - name: nanopb
      revision: 8c60555d6277a0360c876bd85d491fc4fb0cd74a
      path: modules/lib/nanopb
      remote: zmkfirmware
    - name: zmk-studio-messages
      revision: 6cb4c283e76209d59c45fbcb218800cd19e9339d
      path: modules/msgs/zmk-studio-messages
      remote: zmkfirmware
  self:
    west-commands: scripts/west-commands.yml
```
