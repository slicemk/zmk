/dts-v1/;
#include "slicemk_ergodox_202207_green_common.dts"

/ {
    ergodox_a: ergodox_a {
        compatible = "ergodox-a";
        #gpio-cells = <2>;
        gpio-map-mask = <0xffffffff 0xffffffc0>;
        gpio-map-pass-thru = <0 0x3f>;
        gpio-map
            = <0 0 &gpio0 13 0>
            , <1 0 &gpio1 3 0>
            , <2 0 &gpio1 5 0>
            , <3 0 &gpio0 2 0>
            , <4 0 &gpio0 28 0>
            , <5 0 &gpio0 31 0>
            , <6 0 &gpio0 5 0>
            , <7 0 &gpio0 17 0>
            , <8 0 &gpio1 7 0>
            , <9 0 &gpio1 9 0>
            , <10 0 &gpio0 11 0>
            , <11 0 &gpio0 6 0>
            , <12 0 &gpio0 26 0>
            ;
    };

    slicemk_button: slicemk_button {
        compatible = "slicemk-button";
        #gpio-cells = <2>;
        gpio-map-mask = <0xffffffff 0xffffffc0>;
        gpio-map-pass-thru = <0 0x3f>;
        gpio-map = <0 0 &gpio0 24 0>;
    };
};
