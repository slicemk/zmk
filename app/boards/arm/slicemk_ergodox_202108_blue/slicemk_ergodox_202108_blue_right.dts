/dts-v1/;
#include "slicemk_ergodox_202108_blue_common.dts"

/ {
    ergodox_a: ergodox_a {
        compatible = "ergodox-a";
        #gpio-cells = <2>;
        gpio-map-mask = <0xffffffff 0xffffffc0>;
        gpio-map-pass-thru = <0 0x3f>;
        gpio-map
            = <0 0 &gpio0 27 0>
            , <1 0 &gpio1 0 0>
            , <2 0 &gpio1 7 0>
            , <3 0 &gpio1 4 0>
            , <4 0 &gpio0 21 0>
            , <5 0 &gpio0 11 0>
            , <6 0 &gpio0 7 0>
            , <7 0 &gpio0 28 0>
            , <8 0 &gpio0 2 0>
            , <9 0 &gpio0 3 0>
            , <10 0 &gpio1 14 0>
            , <11 0 &gpio1 12 0>
            , <12 0 &gpio1 2 0>
            ;
    };
};
